## fw-esp32/demo-protocols/sdkconfig.defaults
```kconfig
CONFIG_IDF_TARGET="esp32s3"
CONFIG_ESPTOOLPY_FLASHSIZE_16MB=y
CONFIG_FREERTOS_HZ=1000
CONFIG_ESP_CONSOLE_UART_DEFAULT=y
CONFIG_ESP_CONSOLE_SECONDARY_USB_SERIAL_JTAG=y
CONFIG_I2C_ENABLE_SLAVE_DRIVER_VERSION_2=y
```

## fw-esp32/demo-uart/sdkconfig.defaults
```kconfig
CONFIG_IDF_TARGET="esp32s3"
CONFIG_ESPTOOLPY_FLASHSIZE_16MB=y
CONFIG_FREERTOS_HZ=1000
CONFIG_ESP_CONSOLE_UART_DEFAULT=y
CONFIG_ESP_CONSOLE_SECONDARY_USB_SERIAL_JTAG=y
```

## fw-esp32/main/Kconfig.projbuild
```kconfig
menu "Logic analyzer gateway"

    config LA_WIFI_SSID
        string "Wi-Fi SSID"
        default ""
        help
            Station SSID the gateway associates with. Leave empty only for a
            link-only bring-up run. The value is stored in the generated,
            git-ignored build/esp32/sdkconfig, never in tracked sources.

    config LA_WIFI_PASSWORD
        string "Wi-Fi password"
        default ""
        help
            Station password. Empty selects an open network.

    config LA_LINK_WDT_TEST_HOOK
        bool "P8.4 test hook: hang LinkRxTask at start (watchdog fault injection)"
        default n
        help
            Test-only. LinkRxTask stops servicing the task watchdog so the 5 s
            WDT resets the chip. Never enable in a normal build.

    config LA_LINK_BAUD
        int "UART2 analyzer link baud rate"
        default 2000000
        help
            Link rate to the Zynq analyzer; must match the Zynq LA_LINK_BAUD
            (2000000 since the P7.6 gate). P5.5 ran the loopback gate at 921600
            and 2000000. The value lives in the generated, git-ignored
            build/esp32/sdkconfig.

    config LA_SPI_CLOCK_HZ
        int "P9.1 SPI bulk link clock (Hz)"
        default 10000000
        range 1000000 20000000
        help
            SPI master clock for the Zynq axi_quad_spi slave. P9.1 starts at
            10 MHz and moves to 20 MHz only after the bench characterizes the
            200 ohm series-resistor edges (docs/spi-link.md).

    config LA_SPI_ENABLE
        bool "P9.1 SPI bulk link (LinkSpiTask)"
        default y
        help
            Start the SPI master task. Disable for bring-up A/B tests when
            the PL SPI slave is not present or not wired; the UART link and
            the host relay are unaffected.

    config LA_SPI_READY_REQUIRED
        bool "P9.1 SPI data-ready line gates transactions"
        default y
        help
            When enabled, LinkSpiTask only starts a burst while the JA-1
            data-ready line is high (the intended P9.1 handshake). Disable to
            read continuously: the slave sends zeros when its FIFO is empty
            and the la_proto parser drops them, so the link still works when
            the data-ready wire is absent (bring-up fallback; the SPI bus
            stays busy).

    config LA_LINK_UART_SELFTEST
        bool "UART2 internal loopback self-test at boot"
        default n
        help
            Bring-up aid: enable the UART2 internal loopback, write a pattern,
            verify it is received and log PASS/FAIL before the link tasks
            start. Proves the ESP32 UART controller independently of the JD
            ribbon and the Zynq.

endmenu
```
